## sdkconfig.defaults
```kconfig
CONFIG_IDF_TARGET="esp32s3"
CONFIG_ESP_DEFAULT_CPU_FREQ_MHZ_240=y
CONFIG_FREERTOS_HZ=1000

CONFIG_ESPTOOLPY_FLASHSIZE_8MB=y
CONFIG_ESPTOOLPY_FLASHMODE_QIO=y
CONFIG_PARTITION_TABLE_CUSTOM=y
CONFIG_PARTITION_TABLE_CUSTOM_FILENAME="partitions.csv"

CONFIG_SPIRAM=y
CONFIG_SPIRAM_MODE_OCT=y
CONFIG_SPIRAM_SPEED_80M=y
CONFIG_SPIRAM_USE_MALLOC=y
CONFIG_SPIRAM_MALLOC_ALWAYSINTERNAL=16384
CONFIG_SPIRAM_TRY_ALLOCATE_WIFI_LWIP=n

CONFIG_COMPILER_OPTIMIZATION_PERF=y
CONFIG_ESP_CONSOLE_SECONDARY_NONE=y
CONFIG_ESP_CONSOLE_UART_BAUDRATE=115200

CONFIG_CAMERA_MODULE_CUSTOM=y
CONFIG_CAMERA_XCLK_FREQ=20000000
CONFIG_CAMERA_PIN_PWDN=-1
CONFIG_CAMERA_PIN_RESET=-1
CONFIG_CAMERA_PIN_XCLK=10
CONFIG_CAMERA_PIN_SIOD=40
CONFIG_CAMERA_PIN_SIOC=39
CONFIG_CAMERA_PIN_VSYNC=38
CONFIG_CAMERA_PIN_HREF=47
CONFIG_CAMERA_PIN_PCLK=13
CONFIG_CAMERA_PIN_Y2=15
CONFIG_CAMERA_PIN_Y3=17
CONFIG_CAMERA_PIN_Y4=18
CONFIG_CAMERA_PIN_Y5=16
CONFIG_CAMERA_PIN_Y6=14
CONFIG_CAMERA_PIN_Y7=12
CONFIG_CAMERA_PIN_Y8=11
CONFIG_CAMERA_PIN_Y9=48
```
